## configs/buildroot_2019.11_defconfig
```kconfig
BR2_x86_i686=y
BR2_KERNEL_HEADERS_CUSTOM_GIT=y
BR2_KERNEL_HEADERS_CUSTOM_REPO_URL="/labs/linux-lab/linux-stable"
BR2_KERNEL_HEADERS_CUSTOM_REPO_VERSION="v5.1"
BR2_PACKAGE_HOST_LINUX_HEADERS_CUSTOM_5_1=y
BR2_TARGET_GENERIC_HOSTNAME="linux-lab"
BR2_TARGET_GENERIC_ISSUE="Welcome to Linux Lab"
BR2_TARGET_ROOTFS_CPIO=y
BR2_TARGET_ROOTFS_CPIO_GZIP=y
```
